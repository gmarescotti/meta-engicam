VERSION ""

NS_ :

BS_:

BU_: Device Hmi

BO_ 1 test: 8 Device
 SG_ NewSignal_0001 : 0|8@1+ (1,0) [0|0] ""  Hmi

BA_DEF_  "BusType" STRING ;
BA_DEF_ BO_  "GenMsgSendType" ENUM  "cyclic","Asynchronous","IfActive","NotUsed","NotUsed","NotUsed","NotUsed","NotUsed","noMsgSendType";
BA_DEF_ SG_  "PersistentType" ENUM  "NoPersistent","StoreWhenChange","StoreEveryPeriodSec";
BA_DEF_DEF_  "GenMsgSendType" "cyclic";
BA_DEF_DEF_  "PersistentType" "NoPersistent";
BA_ "BusType" "CAN";
