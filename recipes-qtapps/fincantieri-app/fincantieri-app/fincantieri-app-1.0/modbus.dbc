VERSION ""

NS_ :

BS_:

BU_: tcp_powermeter_bytronic Hmi

BO_ 2147523649 Voltage: 4 tcp_powermeter_bytronic
 SG_ Voltage : 7|32@0+ (1,0) [0|1000] "V"  Hmi

BO_ 2147523655 Current: 4 tcp_powermeter_bytronic
 SG_ Current : 7|32@0+ (1,0) [0|200] "A"  Hmi

BO_ 2147523719 Frequency: 4 tcp_powermeter_bytronic
 SG_ Frequency : 0|32@1- (1,0) [0|100] "Hz"  Hmi

BO_ 2147523661 Active_Power: 4 tcp_powermeter_bytronic
 SG_ Active_Power : 0|32@1- (1,0) [0|10000] "W"  Hmi

BO_ 2147513673 Reactive_Power: 4 tcp_powermeter_bytronic
 SG_ Reactive_Power : 0|32@1- (1,0) [0|10000] "W"  Hmi

BO_ 2147513991 Total_Active_Energy: 4 tcp_powermeter_bytronic
 SG_ Total_Active_Energy : 0|32@1- (1,0) [0|1000000] "WH"  Hmi

BO_ 2147513993 Total_Reactive_Energy: 4 tcp_powermeter_bytronic
 SG_ Total_Reactive_Energy : 0|32@1- (1,0) [0|1000000] "WH"  Hmi

BO_ 2147513685 Phase_Angle: 4 tcp_powermeter_bytronic
 SG_ Phase_Angle : -1|32@0- (1,0) [0|360] "gradi"  Hmi

BA_DEF_  "BusType" STRING ;
BA_DEF_ BU_  "StationAddress" INT 1 255;
BA_DEF_DEF_  "BusType" "";
BA_DEF_DEF_  "StationAddress" 1;
BA_ "BusType" "MODBUS";
SIG_VALTYPE_ 2147523719 Frequency : 1;
SIG_VALTYPE_ 2147523661 Active_Power : 1;
SIG_VALTYPE_ 2147513673 Reactive_Power : 1;
SIG_VALTYPE_ 2147513991 Total_Active_Energy : 1;
SIG_VALTYPE_ 2147513993 Total_Reactive_Energy : 1;
SIG_VALTYPE_ 2147513685 Phase_Angle : 1;
