VERSION ""

NS_ :

BS_:

BU_: suprevisor Hmi

BO_ 2147523649 BATTERY_DCDC_STATUS: 2 Hmi
 SG_ BATTERY_DCDC_RUNNING : 0|1@1+ (1,0) [0|0] ""  Hmi
 SG_ BATTERY_DCDC_FAILURE : 1|1@1+ (1,0) [0|0] ""  Hmi

BO_ 2147523651 DCDC_VOLTAGE: 2 Hmi
 SG_ DCDC_VOLTAGE : 0|16@1+ (0.1,0) [0|0] "V"  Hmi

BO_ 2147523652 BATT_DCDC_CURRENT: 2 Hmi
 SG_ BATT_DCDC_CURRENT : 0|16@1- (0.01,0) [0|0] "A"  Hmi

BO_ 2147523653 BATT_DCDC_POWER: 2 Hmi
 SG_ BATT_DCDC_POWER : 0|16@1- (0.01,0) [0|0] "kW"  Hmi

BO_ 2147523654 BATT_DCDC_POWER_LIMITATION: 2 Hmi
 SG_ BATT_DCDC_POWER_LIMITATION : 0|16@1- (0.01,0) [0|0] "kW"  Hmi

BO_ 2147523655 DCDC_COMMAND: 2 Hmi
 SG_ DCDC_RESET2 : 0|1@1+ (1,0) [0|0] ""  Hmi

BO_ 2147513649 BATTERY_STATUS: 2 Hmi
 SG_ BATTERY_STATUS : 0|8@1+ (1,0) [0|0] ""  Hmi

BO_ 2147513650 DCDC_STATUS: 2 Hmi
 SG_ DCDC_STATUS : 0|8@1+ (1,0) [0|0] ""  Hmi

BO_ 2147513651 DCDC_PWR_UNIT_TEMPERATURE: 2 Hmi
 SG_ DCDC_PWR_UNIT_TEMPERATURE : 0|16@1+ (0.1,0) [0|0] "°C"  Hmi

BO_ 2147513652 DCDC_MAX_AVAILABLE_CH_CURRENT: 2 Hmi
 SG_ DCDC_MAX_AVAILABLE_CH_CURRENT : 0|16@1+ (0.1,0) [0|0] "A"  Hmi

BO_ 2147513653 DCDC_MAX_AVAILABLE_D_CURRENT: 2 Hmi
 SG_ DCDC_MAX_AVAILABLE_DIS_CURRENT : 0|16@1+ (0.1,0) [0|0] "A"  Hmi

BO_ 2147513654 DCDC_MAX_AVAILABLE_POWER: 2 Hmi
 SG_ DCDC_MAX_AVAILABLE_POWER : 0|16@1+ (0.01,0) [0|0] "kW"  Hmi

BO_ 2147513655 BATT_VOLTAGE: 2 Hmi
 SG_ BATT_VOLTAGE : 0|16@1+ (0.1,0) [0|0] "V"  Hmi

BO_ 2147513656 BATT_CURRENT: 2 Hmi
 SG_ BATT_CURRENT : 0|16@1- (0.1,0) [0|0] "A"  Hmi

BO_ 2147513657 DC_BUS_VOLTAGE: 2 Hmi
 SG_ DC_BUS_VOLTAGE : 0|16@1+ (0.1,0) [0|0] "V"  Hmi

BO_ 2147513658 DC_BUS_CURRENT: 2 Hmi
 SG_ DC_BUS_CURRENT : 0|16@1- (0.01,0) [0|0] "A"  Hmi

BO_ 2147513699 Msg_30051: 2 Hmi
 SG_ DCDC_ERROR_WORD_1 : 0|16@1+ (1,0) [0|0] "" Vector__XXX

BO_ 2147513700 Msg_30052: 2 Hmi
 SG_ DCDC_ERROR_WORD_2 : 0|16@1+ (1,0) [0|0] "" Vector__XXX

BO_ 2147513709 DCDC_WARNING_WORD_1: 2 Hmi
 SG_ DCDC_WARNING_WORD_1 : 0|16@1+ (1,0) [0|0] "A"  Hmi

BO_ 2147513710 DCDC_WARNING_WORD_2: 2 Hmi
 SG_ DCDC_WARNING_WORD_2 : 0|16@1+ (1,0) [0|0] "A"  Hmi

BO_ 2147513749 Msg_30101: 2 Hmi
 SG_ DCDC_STATUS_WORD_1 : 0|16@1+ (1,0) [0|0] "" Vector__XXX

BA_DEF_  "BusType" STRING ;
BA_DEF_ BU_  "StationAddress" INT 1 255;
BA_DEF_DEF_  "BusType" "";
BA_DEF_DEF_  "StationAddress" 1;
BA_ "BusType" "MODBUS";
